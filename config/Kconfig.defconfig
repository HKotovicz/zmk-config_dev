## config/Kconfig.defconfig
```kconfig
config PWM
    default y

config LED_PWM
    default y


config CUSTOM_RGB_PERKEY
    bool "Per-key layer color RGB effect"
    depends on ZMK_RGB_UNDERGLOW
    default n
    help
      Adds an RGB effect that colors LEDs based on the active layer.
      Color map defined in config/include/rgb_perkey_map.h (generated by PWA).
      Appears in the standard effect cycle via RGB_EFF.

config CUSTOM_RGB_HEATMAP
    bool "Heatmap RGB effect"
    depends on ZMK_RGB_UNDERGLOW
    default n
    help
      Adds an RGB effect that colors LEDs based on keypress frequency.
      Recently pressed keys glow red, fading through blue to off.
      Resets each boot. Appears in the standard effect cycle via RGB_EFF.

config CUSTOM_RGB_BRT_MAX
    int "Custom RGB effects maximum brightness percent (0-100)"
    depends on CUSTOM_RGB_PERKEY || CUSTOM_RGB_HEATMAP
    default 25
    range 0 100
    help
      Maximum brightness for custom RGB effects. Lower values save battery.

config CUSTOM_RGB_HEATMAP_DECAY_MS
    int "Heatmap decay interval in milliseconds"
    depends on CUSTOM_RGB_HEATMAP
    default 25

config CUSTOM_RGB_HEATMAP_BUMP
    int "Heat added per keypress (1-255)"
    depends on CUSTOM_RGB_HEATMAP
    default 32
    range 1 255

config SPLIT_LAYER_STATE_SYNC
    bool "Sync active layer index and name from central to peripherals"
    depends on ZMK_SPLIT
    default y if CUSTOM_RGB_PERKEY
    help
      Sends the active layer index and display name from the central half
      to all peripherals via BLE. Enables the per-key layer color effect
      to show correct colors on the peripheral, and makes the layer name
      available for display widgets.

config SPLIT_LAST_KEYCODE_SYNC
    bool "Sync last pressed keycode name from central to peripherals"
    depends on ZMK_SPLIT
    default y if SPLIT_LAYER_STATE_SYNC
    help
      Sends the display name of the last pressed key from the central
      half to all peripherals via BLE. Enables a "last key" widget on
      peripheral displays — useful for learning new layouts.

config SPLIT_TYPING_STATS_SYNC
    bool "Sync typing statistics (WPM + keystroke count) to peripherals"
    depends on ZMK_SPLIT
    default y if SPLIT_LAST_KEYCODE_SYNC
    help
      Sends WPM and cumulative keystroke count from the central half
      to all peripherals via BLE once per second while typing. Enables
      a typing dashboard widget on peripheral displays.

config LAYER_AWARE_BACKLIGHT
    bool "Toggle PWM backlight per layer"
    depends on ZMK_BACKLIGHT
    default n
    help
      Turns the PWM backlight off on the base layer (0) and on for
      any other active layer. Works on both central and peripheral
      halves (peripheral requires SPLIT_LAYER_STATE_SYNC).
```
